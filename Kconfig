## Kconfig
```kconfig
menuconfig RADIO_CTRL
    bool "Custom Radio controller drivers"
    help
    Enable YourCo radio controller drivers (SX1262-based, etc).

if RADIO_CTRL
    config RADIO_CTRL_SX1262
        bool "DA SX1262 radio driver"
        depends on SPI && EVENTS
        default y if DT_HAS_YOURCO_SX1262_RADIO_ENABLED
        help
        Enable driver for SX1262-based radio using your custom API.
    config RADIO_CTRL_LOG_LEVEL
        int "Radio controller driver log level"
        default 3
        help
        Set the log level for the radio controller driver (0-4).
    config RADIO_CTRL_INIT_PRIORITY
        int "Radio controller driver init priority"
        default 90
        help
        Set the initialization priority for the radio controller driver.
endif # RADIO_CTRL
```

## dts/bindings/radio/da,sx126x-radio.yaml
```yaml
compatible: "da,sx126x-radio"
description: Semtech SX126x LoRa/FSK radio transceiver

include:
  - name: spi-device.yaml

properties:
    # Status is inherited, but often included for clarity
    status:
        type: string
        required: true
        default: "disabled"

    nreset-gpios:
        type: phandle-array
        required: true
        description: GPIO pin used for the hardware reset (nRESET)

    busy-gpios:
        type: phandle-array
        required: true
        description: GPIO pin used to signal BUSY state from the radio

    dio1-gpios:
        type: phandle-array
        required: true
        description: GPIO pin used for radio interrupts (DIO1)

    dio2-gpios:
        type: phandle-array
        required: false
        description: GPIO pin used for radio interrupts (DIO2)

    xtal-sel-gpios:
        type: phandle-array
        required: false
        description: GPIO pin used to select the crystal oscillator (XTAL)

    freq-sel-gpios:
        type: phandle-array
        required: false
        description: GPIO pin used to select the frequency band (FREQ_SEL)

    antenna-switch-gpios:
        type: phandle-array
        required: false
        description: Optional GPIO to enable/disable the RF switch or LNA
```
